## boards/arm/bbt_skr_v13/Kconfig.board
```kconfig
# BIGTREETECH SKR V1.3

# SPDX-License-Identifier: Apache-2.0

config BOARD_BBT_SKR_V13
	bool "BIGTREETECH SKR V1.3"
	depends on SOC_SERIES_LPC17XX
	select SOC_PART_NUMBER_LPC1768
```

## boards/arm/bbt_skr_v13/Kconfig.defconfig
```kconfig
# BIGTREETECH SKR V1.3

# SPDX-License-Identifier: Apache-2.0

if BOARD_BBT_SKR_V13

config BOARD
	default "bbt_skr_v13"

endif # BOARD_BBT_SKR_V13
```

## soc/arm/nxp_lpc/lpc176x/Kconfig.defconfig.lpc1768
```kconfig
# NXP LPC1768 platform configuration options

# SPDX-License-Identifier: Apache-2.0

if SOC_LPC1768

config SOC
	default "lpc1768"

endif # SOC_LPC1768
```

## soc/arm/nxp_lpc/lpc176x/Kconfig.series
```kconfig
# LPC LPC176X MCU line

# SPDX-License-Identifier: Apache-2.0

config SOC_SERIES_LPC176X
	bool "LPC LPC176X Series MCU"
	select ARM
	select CPU_CORTEX_M3
	select CPU_CORTEX_M_HAS_SYSTICK
	select SOC_FAMILY_LPC
	select PINMUX
	select CLOCK_CONTROL
	help
	  Enable support for LPC LPC176X MCU series
```

## soc/arm/nxp_lpc/lpc176x/Kconfig.soc
```kconfig
# LPC LPC176x MCU line

# SPDX-License-Identifier: Apache-2.0

choice
	prompt "LPC LPC176X MCU Selection"
	depends on SOC_SERIES_LPC176X

config SOC_LPC1768
	bool "SOC_LPC1768"

endchoice

if SOC_SERIES_LPC176X

config SOC_PART_NUMBER_LPC1768

endif # SOC_SERIES_LPC176X
```
